## digital_pen_ov5640/components/network_manager/Kconfig
```kconfig
menu "Digital pen network"

    config DIGITAL_PEN_WIFI_SSID
        string "Development Wi-Fi SSID"
        default ""
        help
            2.4 GHz network used by the development frame transport.
            Keep the actual value in the git-ignored local sdkconfig.

    config DIGITAL_PEN_WIFI_PASSWORD
        string "Development Wi-Fi password"
        default ""
        help
            Password for the development Wi-Fi network. This value must only
            be stored in the git-ignored local sdkconfig.

    config DIGITAL_PEN_WIFI_TIMEOUT_SECONDS
        int "STA DHCP timeout before SoftAP fallback"
        range 1 120
        default 15

endmenu
```

## digital_pen_ov5640/sdkconfig.defaults
```kconfig
CONFIG_ESPTOOLPY_FLASHSIZE_16MB=y

CONFIG_SPIRAM=y
CONFIG_SPIRAM_MODE_OCT=y
CONFIG_SPIRAM_TYPE_AUTO=y
CONFIG_SPIRAM_SPEED_80M=y
CONFIG_SPIRAM_BOOT_INIT=y
CONFIG_SPIRAM_USE_MALLOC=y
CONFIG_SPIRAM_MEMTEST=y
CONFIG_SPIRAM_MALLOC_ALWAYSINTERNAL=16384
CONFIG_SPIRAM_MALLOC_RESERVE_INTERNAL=32768

CONFIG_OV5640_SUPPORT=y
# CONFIG_OV7670_SUPPORT is not set
# CONFIG_OV7725_SUPPORT is not set
# CONFIG_NT99141_SUPPORT is not set
# CONFIG_OV2640_SUPPORT is not set
# CONFIG_OV3660_SUPPORT is not set
# CONFIG_GC2145_SUPPORT is not set
# CONFIG_GC032A_SUPPORT is not set
# CONFIG_GC0308_SUPPORT is not set
# CONFIG_BF3005_SUPPORT is not set
# CONFIG_BF20A6_SUPPORT is not set
# CONFIG_SC101IOT_SUPPORT is not set
# CONFIG_SC030IOT_SUPPORT is not set
# CONFIG_SC031GS_SUPPORT is not set
# CONFIG_HM1055_SUPPORT is not set
# CONFIG_HM0360_SUPPORT is not set
# CONFIG_MEGA_CCM_SUPPORT is not set
CONFIG_CAMERA_TASK_STACK_SIZE=4096
CONFIG_CAMERA_CORE0=y
CONFIG_CAMERA_DMA_BUFFER_SIZE_MAX=32768
CONFIG_CAMERA_PSRAM_DMA=y
```
